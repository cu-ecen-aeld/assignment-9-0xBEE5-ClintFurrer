## base_external/package/aesdchar/Config.in
```kconfig
config BR2_PACKAGE_AESDCHAR
	bool "aesdchar"
	depends on BR2_LINUX_KERNEL
	help
	  Builds and installs the misc-modules and scull kernel components.
```
